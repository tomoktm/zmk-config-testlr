## boards/shields/dtest/Kconfig.defconfig
```kconfig
if SHIELD_DTEST_D

config ZMK_KEYBOARD_NAME
    default "dtest_d"

config ZMK_USB
    default y

config ZMK_SPLIT
    default y

config ZMK_SPLIT_ROLE_CENTRAL
    default y
    
config ZMK_SPLIT_BLE_CENTRAL_PERIPHERALS
    default 2

config BT_MAX_CONN
    default 6

config BT_MAX_PAIRED
    default 6

endif

if SHIELD_DTEST_L

config ZMK_SPLIT
    default y
    
config ZMK_SPLIT_ROLE_CENTRAL
    default n

endif
```

## boards/shields/dtest/Kconfig.shield
```kconfig
# Copyright (c) 2020 Pete Johanson
# SPDX-License-Identifier: MIT

config SHIELD_DTEST_D
    def_bool $(shields_list_contains,dtest_d)
    
config SHIELD_DTEST_L
    def_bool $(shields_list_contains,dtest_l)
```

## boards/shields/testlr/Kconfig.shield
```kconfig
# Copyright (c) 2020 Pete Johanson
# SPDX-License-Identifier: MIT

config SHIELD_TEST_L
    def_bool $(shields_list_contains,test_l)
    
config SHIELD_TEST_R
    def_bool $(shields_list_contains,test_r)
```
